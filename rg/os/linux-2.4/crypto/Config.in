## rg/os/linux-2.4/crypto/Config.in
```kconfig
# $Id: Config.in,v 1.1.1.1 2006/01/20 03:16:22 zjjiang Exp $

mainmenu_option next_comment
comment 'Cryptography support (CryptoAPI)'

tristate 'CryptoAPI support' CONFIG_CRYPTO

dep_mbool 'Cipher Algorithms' CONFIG_CIPHERS $CONFIG_CRYPTO
source crypto/ciphers/Config.in

dep_mbool 'Digest Algorithms' CONFIG_DIGESTS $CONFIG_CRYPTO
source crypto/digests/Config.in

dep_mbool 'Crypto Devices' CONFIG_CRYPTODEV $CONFIG_CRYPTO
source crypto/drivers/Config.in

endmenu
```
